#include "oled.h"

static uint8_t SH1106_Buffer[1024];

/* Bảng mã Font 5x7 cơ bản */
static const uint8_t Font5x7[][5] = {
    {0x00, 0x00, 0x00, 0x00, 0x00}, // Space
    {0x00, 0x00, 0x5F, 0x00, 0x00}, // !
    {0x00, 0x07, 0x00, 0x07, 0x00}, // "
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    {0x44, 0x64, 0x54, 0x4C, 0x44}  // z
};

static void OLED_Delay(uint32_t ms) {
    for (uint32_t i = 0; i < ms * 7200; i++) {
        __NOP();
    }
}

static void I2C_StartTransmission(void) {
    while (I2C_GetFlagStatus(OLED_I2C_PORT, I2C_FLAG_BUSY));
    I2C_GenerateSTART(OLED_I2C_PORT, ENABLE);
    while (!I2C_CheckEvent(OLED_I2C_PORT, I2C_EVENT_MASTER_MODE_SELECT));
    I2C_Send7bitAddress(OLED_I2C_PORT, OLED_I2C_ADDR, I2C_Direction_Transmitter);
    while (!I2C_CheckEvent(OLED_I2C_PORT, I2C_EVENT_MASTER_TRANSMITTER_MODE_SELECTED));
}

static void SH1106_WriteCommand(uint8_t cmd) {
    I2C_StartTransmission();
    I2C_SendData(OLED_I2C_PORT, 0x00);
    while (!I2C_CheckEvent(OLED_I2C_PORT, I2C_EVENT_MASTER_BYTE_TRANSMITTED));
    I2C_SendData(OLED_I2C_PORT, cmd);
    while (!I2C_CheckEvent(OLED_I2C_PORT, I2C_EVENT_MASTER_BYTE_TRANSMITTED));
    I2C_GenerateSTOP(OLED_I2C_PORT, ENABLE);
}

void SH1106_Init(void) {
    GPIO_InitTypeDef GPIO_InitStructure;
    I2C_InitTypeDef I2C_InitStructure;

    OLED_GPIO_CLK_CMD(OLED_GPIO_CLK, ENABLE);
    OLED_I2C_CLK_CMD(OLED_I2C_CLK, ENABLE);
    RCC_APB2PeriphClockCmd(RCC_APB2Periph_AFIO, ENABLE);
    GPIO_PinRemapConfig(GPIO_Remap_I2C1, ENABLE);

    GPIO_InitStructure.GPIO_Pin = OLED_SCL_PIN | OLED_SDA_PIN;
    GPIO_InitStructure.GPIO_Mode = GPIO_Mode_AF_OD;
    GPIO_InitStructure.GPIO_Speed = GPIO_Speed_50MHz;
    GPIO_Init(OLED_GPIO_PORT, &GPIO_InitStructure);

    I2C_InitStructure.I2C_Mode = I2C_Mode_I2C;
    I2C_InitStructure.I2C_DutyCycle = I2C_DutyCycle_2;
    I2C_InitStructure.I2C_OwnAddress1 = 0x00;
    I2C_InitStructure.I2C_Ack = I2C_Ack_Enable;
    I2C_InitStructure.I2C_AcknowledgedAddress = I2C_AcknowledgedAddress_7bit;
    I2C_InitStructure.I2C_ClockSpeed = 400000;
    I2C_Init(OLED_I2C_PORT, &I2C_InitStructure);
    I2C_Cmd(OLED_I2C_PORT, ENABLE);

    SH1106_WriteCommand(0xAE); 
    SH1106_WriteCommand(0xD5); SH1106_WriteCommand(0x80);
    SH1106_WriteCommand(0xA8); SH1106_WriteCommand(0x3F);
    SH1106_WriteCommand(0xD3); SH1106_WriteCommand(0x00);
    SH1106_WriteCommand(0x40); 
    SH1106_WriteCommand(0xAD); SH1106_WriteCommand(0x8B);
    SH1106_WriteCommand(0x33); 
    SH1106_WriteCommand(0xA1); 
    SH1106_WriteCommand(0xC8); 
    SH1106_WriteCommand(0xDA); SH1106_WriteCommand(0x12);
    SH1106_WriteCommand(0x81); SH1106_WriteCommand(0xBF);
    SH1106_WriteCommand(0xD9); SH1106_WriteCommand(0x22);
    SH1106_WriteCommand(0xDB); SH1106_WriteCommand(0x40);
    SH1106_WriteCommand(0xA4); 
    SH1106_WriteCommand(0xA6); 
    SH1106_WriteCommand(0xAF); 
}

void SH1106_UpdateScreen(void) {
    for (uint8_t page = 0; page < 8; page++) {
        SH1106_WriteCommand(0xB0 + page);
        SH1106_WriteCommand(0x00); 
        SH1106_WriteCommand(0x10);

        I2C_StartTransmission();
        I2C_SendData(OLED_I2C_PORT, 0x40);
        while (!I2C_CheckEvent(OLED_I2C_PORT, I2C_EVENT_MASTER_BYTE_TRANSMITTED));

        for (uint8_t col = 0; col < 128; col++) {
            I2C_SendData(OLED_I2C_PORT, SH1106_Buffer[col + page * 128]);
            while (!I2C_CheckEvent(OLED_I2C_PORT, I2C_EVENT_MASTER_BYTE_TRANSMITTED));
        }
        I2C_GenerateSTOP(OLED_I2C_PORT, ENABLE);
    }
}

void SH1106_Clear(void) {
    for (uint16_t i = 0; i < 1024; i++) {
        SH1106_Buffer[i] = 0x00;
    }
}

void SH1106_DrawPixel(uint8_t x, uint8_t y, uint8_t color) {
    if (x >= OLED_WIDTH || y >= OLED_HEIGHT) return;
    if (color) SH1106_Buffer[x + (y / 8) * OLED_WIDTH] |= (1 << (y % 8));
    else       SH1106_Buffer[x + (y / 8) * OLED_WIDTH] &= ~(1 << (y % 8));
}

void OLED_DrawChar(uint8_t x, uint8_t y, char c, uint8_t color) {
    if (c < 32 || c > 126) return;
    uint8_t char_idx = c - 32;
    for (uint8_t col = 0; col < 5; col++) {
        uint8_t line = Font5x7[char_idx][col];
        for (uint8_t row = 0; row < 7; row++) {
            if ((line >> row) & 0x01) SH1106_DrawPixel(x + col, y + row, color);
            else                      SH1106_DrawPixel(x + col, y + row, !color);
        }
    }
}

void OLED_DrawString(uint8_t x, uint8_t y, const char *str, uint8_t color) {
    while (*str) {
        if (x + 6 > OLED_WIDTH) { x = 0; y += 8; }
        if (y + 7 > OLED_HEIGHT) break;
        OLED_DrawChar(x, y, *str, color);
        x += 6; 
        str++;
    }
}

void OLED_DrawRect(uint8_t x, uint8_t y, uint8_t w, uint8_t h, uint8_t color) {
    for (uint8_t i = 0; i < w; i++) {
        SH1106_DrawPixel(x + i, y, color);
        SH1106_DrawPixel(x + i, y + h - 1, color);
    }
    for (uint8_t i = 0; i < h; i++) {
        SH1106_DrawPixel(x, y + i, color);
        SH1106_DrawPixel(x + w - 1, y + i, color);
    }
}

void OLED_TestDeadPixel(void) {
    for (uint16_t i = 0; i < 1024; i++) SH1106_Buffer[i] = 0xFF; 
    SH1106_UpdateScreen();
    OLED_Delay(2000); 

    for (uint16_t i = 0; i < 1024; i++) SH1106_Buffer[i] = 0x00; 
    SH1106_UpdateScreen();
    OLED_Delay(2000);

    for (uint16_t i = 0; i < 1024; i++) SH1106_Buffer[i] = 0xAA; 
    SH1106_UpdateScreen();
    OLED_Delay(2000);

    for (uint16_t i = 0; i < 1024; i++) SH1106_Buffer[i] = 0x55; 
    SH1106_UpdateScreen();
    OLED_Delay(2000);
}
